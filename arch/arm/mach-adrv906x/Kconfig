## arch/arm/mach-adrv906x/Kconfig
```kconfig
# SPDX-License-Identifier: GPL-2.0+
#
# (C) Copyright 2024 Analog Devices, Inc.

menu "ADI ADRV906X board type"
	depends on ARCH_ADRV906X

choice
	prompt "Board type select"
	default TARGET_ADRV906X_EVAL

config TARGET_ADRV906X_EVAL
	bool "ADRV906X evaluation board"

endchoice

source "board/adi/adrv906x_eval/Kconfig"

endmenu
```

## board/adi/adrv906x_eval/Kconfig
```kconfig
menu "ADI ADRV906X evaluation board"
	depends on TARGET_ADRV906X_EVAL

config SYS_CONFIG_NAME
        string "Board configuration name"
	default "adi_adrv906x_eval"
        help
          This option contains information about board configuration name.
          Based on this option include/configs/<CONFIG_SYS_CONFIG_NAME>.h header
          will be used for board configuration.

config SYS_BOARD
	string "Board name"
	default "adrv906x_eval"

endmenu

config SYS_VENDOR
	string 
	depends on TARGET_ADRV906X_EVAL
	default "adi"

config SYS_SOC
	string
	depends on TARGET_ADRV906X_EVAL
	default "adrv906x"

config CMD_ADI_EXT_UTILS
	bool "Enable Analog Devices-specific U-Boot commands"
	default n
	help
	  Enable ADI-specific U-Boot commands such as trusted app hosts.

config ADI_ADRV_DEBUG
	bool "Enable ADRV debug version features"
	default n
	help
	  Enable ADI-specific U-Boot debug features
```

## cmd/adi/Kconfig
```kconfig
menu "ADI commands"
depends on CMD_ADI_EXT_UTILS

source "cmd/adi/tee/Kconfig"

endmenu
```

## cmd/adi/tee/Kconfig
```kconfig
menu "TEE commands"
depends on TEE

config CMD_TEE_EXAMPLE_EARLY
	bool "The example_early Trusted Application Host"
	default n
	help
	  The Trusted Application Host for example_early, which is
	  simply a demonstration app showing how to interact between
	  U-Boot and the Trusted Execution Environment.

endmenu
```

## configs/adrv906x-eval_defconfig
```kconfig
CONFIG_ARM=y
# CONFIG_ARM64_SUPPORT_AARCH32 is not set
CONFIG_ARCH_ADRV906X=y
CONFIG_SYS_TEXT_BASE=0x48000000
CONFIG_SYS_MALLOC_F_LEN=0x2000
CONFIG_NR_DRAM_BANKS=1
CONFIG_ENV_SIZE=0x40000
CONFIG_DM_GPIO=y
CONFIG_DEFAULT_DEVICE_TREE="adrv906x-eval"
CONFIG_CMD_ADI_EXT_UTILS=y
CONFIG_IDENT_STRING=" adrv906x"
# CONFIG_PSCI_RESET is not set
CONFIG_ENV_VARS_UBOOT_CONFIG=y
CONFIG_FIT=y
CONFIG_FIT_SIGNATURE=y
# CONFIG_FIT_PRINT is not set
CONFIG_OF_SYSTEM_SETUP=y
CONFIG_BOOTSTAGE=y
CONFIG_BOOTSTAGE_RECORD_COUNT=50
CONFIG_BOOTDELAY=-2
CONFIG_USE_BOOTCOMMAND=y
CONFIG_BOOTCOMMAND="run adrv_bootcmd"
CONFIG_PANIC_ON_CONSOLE_INPUT=y
CONFIG_LOG=y
# CONFIG_DISPLAY_CPUINFO is not set
# CONFIG_DISPLAY_BOARDINFO is not set
CONFIG_ARCH_MISC_INIT=y
CONFIG_HUSH_PARSER=y
CONFIG_SYS_PROMPT="adrv906x# "
# CONFIG_CMD_CONSOLE is not set
# CONFIG_CMD_BOOTD is not set
# CONFIG_CMD_BOOTI is not set
# CONFIG_BOOTM_NETBSD is not set
# CONFIG_BOOTM_PLAN9 is not set
# CONFIG_BOOTM_RTEMS is not set
# CONFIG_BOOTM_VXWORKS is not set
# CONFIG_CMD_ELF is not set
# CONFIG_CMD_GO is not set
# CONFIG_CMD_XIMG is not set
# CONFIG_CMD_EXPORTENV is not set
# CONFIG_CMD_IMPORTENV is not set
# CONFIG_CMD_EDITENV is not set
# CONFIG_CMD_SAVEENV is not set
CONFIG_CMD_UNZIP=y
CONFIG_CMD_GPIO=y
CONFIG_CMD_GPT=y
# CONFIG_RANDOM_UUID is not set
# CONFIG_CMD_LOADB is not set
# CONFIG_CMD_LOADS is not set
CONFIG_CMD_MMC=y
CONFIG_CMD_MTD=y
CONFIG_CMD_PART=y
CONFIG_CMD_WDT=y
# CONFIG_CMD_ITEST is not set
CONFIG_CMD_SETEXPR_FMT=y
CONFIG_CMD_CACHE=y
# CONFIG_CMD_SLEEP is not set
CONFIG_CMD_EXT4=y
CONFIG_CMD_FS_GENERIC=y
CONFIG_OF_CONTROL=y
CONFIG_OF_BOARD=y
# CONFIG_NET is not set
CONFIG_CLK=y
CONFIG_CLK_ADI_ADRV906X_1G=y
CONFIG_ADI_ADRV906X_GPIO=y
CONFIG_MMC_BROKEN_CD=y
CONFIG_ARM_PL180_MMCI=y
CONFIG_MMC_HS400_ES_SUPPORT=y
CONFIG_MMC_HS400_SUPPORT=y
CONFIG_MMC_SDHCI_ADI=y
CONFIG_MMC_SDHCI=y
CONFIG_MMC_SDHCI_SDMA=y
CONFIG_MTD=y
CONFIG_DM_MTD=y
CONFIG_DM_SPI_FLASH=y
CONFIG_SPI_FLASH_SFDP_SUPPORT=y
CONFIG_SPI_FLASH_STMICRO=y
CONFIG_SPI_FLASH_MTD=y
CONFIG_DM_ETH=y
CONFIG_PHY_ADI_SDHCI=y
CONFIG_PINCTRL=y
CONFIG_DM_SERIAL=y
CONFIG_PL01X_SERIAL=y
CONFIG_SPI=y
CONFIG_DM_SPI=y
CONFIG_ADI_SPI3_DM=y
CONFIG_TEE=y
CONFIG_OPTEE=y
CONFIG_WDT=y
CONFIG_WDT_SMC=y
CONFIG_REGEX=y
CONFIG_RSA_VERIFY_WITH_PKEY=y
CONFIG_LZ4=y
CONFIG_LZMA=y
# CONFIG_EFI_LOADER is not set
```

## drivers/phy/adi/Kconfig
```kconfig
#
# Phy drivers for ADI platforms
#

config PHY_ADI_SDHCI
	tristate "ADI SDHCI PHY driver"
	select PHY
	help
	  Enable this to support the ADI SDHCI PHY.
```
