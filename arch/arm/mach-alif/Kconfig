## arch/arm/mach-alif/Kconfig
```kconfig
if ARCH_ALIF

config SYS_SOC
	default "alif"

choice
	prompt "Alif Ensemble board select"
	optional
	help
	  Select the Alif Ensemble board to build U-Boot for.

config TARGET_ALIF_DEVKIT_E8
	bool "Alif Ensemble DevKit-E8"
	select CPU_V7A
	select SYS_ARCH_TIMER
	select SKIP_LOWLEVEL_INIT
	select SYS_DCACHE_OFF
	select SYS_ICACHE_OFF
	select ARCH_SUPPORT_PSCI
	imply NS16550
	imply SYS_NS16550
	imply PINCTRL
	imply PINCTRL_ALIF_ENSEMBLE
	help
	  The Ensemble E8 has two Cortex-A32 cores and executes in place from
	  the on-chip MRAM. U-Boot is started by TF-A (BL32/SP_MIN) as BL33.

endchoice

source "board/alif/devkit_e8/Kconfig"

endif
```

## board/adi/sc846-som/Kconfig
```kconfig
# SPDX-License-Identifier: GPL-2.0-or-later
#
# (C) Copyright 2026 - Analog Devices, Inc.

if TARGET_SC846_SOM

config LDR_CPU
	default "ADSP-SC846-0.0"

config SYS_BOARD
	default "sc846-som"

config SYS_CONFIG_NAME
	default "sc846-som"

config DEFAULT_DEVICE_TREE
	default "sc846-som"

config ADI_IMAGE
	default "minimal"

config CUSTOM_SYS_INIT_SP_ADDR
	default 0x96000000

# SPL

config SPL_OF_LIBFDT_ASSUME_MASK
	default 0x0

# SPI Flash

config SF_DEFAULT_BUS
	default 2

config SF_DEFAULT_CS
	default 1

config SF_DEFAULT_SPEED
	default 10000000

# Clock Configs

config CGU0_DF_DIV
	default 0

# MSEL
config CGU0_VCO_MULT
	default 80

# Core Clock divider
config CGU0_CCLK_DIV
	default 1

# System Clock divider
config CGU0_SCLK_DIV
	default 2

config CGU0_SCLK0_DIV
	default 4

config CGU0_SCLK1_DIV
	default 2

# DDR Clock divider
config CGU0_DCLK_DIV
	default 2

# Output Clock divider
config CGU0_OCLK_DIV
	default 10

# SCLK1 extended divisor
config CGU0_DIV_S1SELEX
	default 3

# CGU1 MSEL
config CGU1_VCO_MULT
	default 72

config CGU1_DF_DIV
	default 0

# Core Clock divider
config CGU1_CCLK_DIV
	default 2

# System Clock divider
config CGU1_SCLK_DIV
	default 5

config CGU1_SCLK0_DIV
	default 4

config CGU1_SCLK1_DIV
	default 2

# Linkport Clock divider
config CGU1_DCLK_DIV
	default 3

# Output Clock divider
config CGU1_OCLK_DIV
	default 8

# SCLK1 extended divisor
config CGU1_DIV_S0SELEX
	default 8

# SCLK1 extended divisor
config CGU1_DIV_S1SELEX
	default 5

# SHARC-FX

config CDU0_CLKO0
	default 1

# CORE 0
config CDU0_CLKO1
	default 3

# CORE 1
config CDU0_CLKO2
	default 7

# DDR
config CDU0_CLKO3
	default 1

# CAN
# 1 sets the input as OCLK_0
# OCLK_0 = CGU0_VCO / 40 = 100MHz
config CDU0_CLKO4
	default 1

# SPDIF
# 1 sets the input as SCLK1_0
# SCLK1_0 = CGU0_VCO / 12 = 333MHz
config CDU0_CLKO5
	default 1

# SPI
config CDU0_CLKO6
	default 1

# GIGE
config CDU0_CLKO7
	default 1

# xSPI2
# 5 sets the input as SCLK1_1
# SCLK1_0 = CGU1_VCO / 20 = 180MHz
config CDU0_CLKO8
	default 5

# LINKPORT
# 5 sets the input as SCLK1_0
# SCLK1_0 = CGU1_VCO / 12 = 300MHz
config CDU0_CLKO9
	default 5

endif
```

## board/alif/devkit_e8/Kconfig
```kconfig
if TARGET_ALIF_DEVKIT_E8

config SYS_BOARD
	default "devkit_e8"

config SYS_VENDOR
	default "alif"

config SYS_CONFIG_NAME
	default "alif_devkit_e8"

config TEXT_BASE
	default 0x80020000

config BOARD_SPECIFIC_OPTIONS # dummy
	def_bool y
	select HAS_CUSTOM_SYS_INIT_SP_ADDR

endif
```

## board/xilinx/zynq/Kconfig
```kconfig
# SPDX-License-Identifier: GPL-2.0
#
# Copyright (c) 2018, Xilinx, Inc.

if ARCH_ZYNQ

config CMD_ZYNQ
	bool "Enable Zynq specific commands"
	default y
	help
	  Enables Zynq specific commands.

config CMD_ZYNQ_AES
	bool "Enable zynq aes command for decryption of encrypted images"
	depends on CMD_ZYNQ
	depends on FPGA_ZYNQPL
	help
	  Decrypts the encrypted image present in source address
	  and places the decrypted image at destination address.

config CMD_ZYNQ_RSA
	bool "Enable zynq rsa command for loading secure images"
	default y
	depends on CMD_ZYNQ
	depends on CMD_ZYNQ_AES
	help
	  Enabling this will support zynq secure image verification.
	  The secure image is a xilinx specific BOOT.BIN with
	  either authentication or encryption or both encryption
	  and authentication feature enabled while generating
	  BOOT.BIN using Xilinx bootgen tool.

config CMD_ADI_HWREF
	bool "ADI hardware reference detection commands"
	depends on ARCH_ZYNQ
	help
	  Enables adi_hwref, xadc, and envversion commands for
	  Analog Devices PlutoSDR, M2K, and SidekiqZ2 boards.
	  Provides XADC voltage reading and board revision detection.

config SPI_FLASH_LOCK_ADI
	bool "ADI PlutoSDR/M2K bottom 1MB flash protection"
	depends on SPI_FLASH_LOCK
	help
	  Override SPI flash lock/unlock for Analog Devices PlutoSDR,
	  M2K, and SidekiqZ2 boards. Protects the bottom 1MB (boot
	  partition) by writing SR with BP2|BP0|TB directly, bypassing
	  the generic Micron lock which does not handle bottom protect
	  correctly on N25Q256.

endif
```

## configs/adi_zynqmp_adrv9009_zu11eg_adrv2crr_fmc_defconfig
```kconfig
CONFIG_ARM=y
CONFIG_POSITION_INDEPENDENT=y
CONFIG_ARCH_ZYNQMP=y
CONFIG_TEXT_BASE=0x8000000
CONFIG_SYS_MALLOC_LEN=0x4040000
CONFIG_SYS_MALLOC_F_LEN=0x8000
CONFIG_SF_DEFAULT_SPEED=50000000
CONFIG_DM_GPIO=y
CONFIG_SYS_CONFIG_NAME="adi_zynqmp_adrv9009_zu11eg"
CONFIG_DEFAULT_DEVICE_TREE="zynqmp-adrv9009-zu11eg-adrv2crr-fmc"
CONFIG_OF_LIBFDT_OVERLAY=y
CONFIG_DM_RESET=y
CONFIG_SPL_STACK_R_ADDR=0x18000000
CONFIG_SPL_STACK=0xfffffffc
CONFIG_SPL_BSS_MAX_SIZE=0x80000
CONFIG_SPL_STACK_R=y
CONFIG_SYS_BOOTM_LEN=0x6400000
CONFIG_SYS_LOAD_ADDR=0x8000000
CONFIG_SPL_SIZE_LIMIT=0x2a000
CONFIG_SPL=y
CONFIG_SPL_SPI_FLASH_SUPPORT=y
CONFIG_SPL_SPI=y
CONFIG_AHCI=y
CONFIG_SYS_MEMTEST_START=0x00000000
CONFIG_SYS_MEMTEST_END=0x00001000
CONFIG_REMAKE_ELF=y
CONFIG_FIT=y
CONFIG_FIT_VERBOSE=y
CONFIG_SPL_LOAD_FIT=y
CONFIG_SPL_LOAD_FIT_ADDRESS=0x10000000
CONFIG_DISTRO_DEFAULTS=y
# CONFIG_ARCH_FIXUP_FDT_MEMORY is not set
CONFIG_USE_BOOTARGS=y
CONFIG_BOOTARGS="earlycon clk_ignore_unused"
CONFIG_USE_BOOTCOMMAND=y
CONFIG_BOOTCOMMAND="run $modeboot || run distro_bootcmd"
CONFIG_SYS_PBSIZE=2073
CONFIG_BOARD_EARLY_INIT_R=y
CONFIG_CLOCKS=y
CONFIG_SPL_MAX_SIZE=0x40000
# CONFIG_SPL_BINMAN_SYMBOLS is not set
# CONFIG_SPL_SHARES_INIT_SP_ADDR is not set
CONFIG_SPL_SYS_MALLOC=y
CONFIG_SPL_HAS_CUSTOM_MALLOC_START=y
CONFIG_SPL_CUSTOM_SYS_MALLOC_ADDR=0x20000000
CONFIG_SPL_SYS_MALLOC_SIZE=0x1000000
CONFIG_SPL_FS_LOAD_KERNEL_NAME="atf-uboot.ub"
CONFIG_SPL_FS_LOAD_ARGS_NAME="u-boot.bin"
CONFIG_SPL_FPGA=y
CONFIG_SPL_OS_BOOT=y
CONFIG_SPL_PAYLOAD_ARGS_ADDR=0x8000000
CONFIG_SPL_RAM_DEVICE=y
CONFIG_SPL_SPI_LOAD=y
CONFIG_SYS_SPI_U_BOOT_OFFS=0x100000
CONFIG_SPL_ATF=y
CONFIG_SPL_ATF_NO_PLATFORM_PARAM=y
CONFIG_SYS_PROMPT="ADRV9009-ZU11EG> "
CONFIG_FASTBOOT=y
CONFIG_FASTBOOT_FLASH=y
CONFIG_FASTBOOT_FLASH_MMC_DEV=0
CONFIG_CMD_THOR_DOWNLOAD=y
CONFIG_CMD_MEMTEST=y
CONFIG_CMD_CLK=y
CONFIG_CMD_DFU=y
# CONFIG_CMD_FLASH is not set
CONFIG_CMD_FPGA_LOADBP=y
CONFIG_CMD_FPGA_LOADP=y
CONFIG_CMD_FPGA_LOAD_SECURE=y
CONFIG_CMD_GPIO=y
CONFIG_CMD_GPT=y
CONFIG_CMD_I2C=y
CONFIG_DM_I2C=y
CONFIG_SYS_I2C_CADENCE=y
CONFIG_I2C_MUX=y
CONFIG_I2C_MUX_PCA954x=y
CONFIG_CMD_MMC=y
CONFIG_CMD_SF=y
CONFIG_CMD_USB=y
CONFIG_CMD_TFTPPUT=y
CONFIG_CMD_CACHE=y
CONFIG_CMD_EXT4_WRITE=y
CONFIG_SPL_OF_CONTROL=y
CONFIG_OF_EMBED=y
CONFIG_ENV_IS_IN_FAT=y
CONFIG_NET_RANDOM_ETHADDR=y
CONFIG_SPL_DM=y
CONFIG_SPL_DM_SEQ_ALIAS=y
CONFIG_SCSI_AHCI=y
CONFIG_SATA_CEVA=y
CONFIG_CLK_ZYNQMP=y
CONFIG_DFU_RAM=y
CONFIG_FPGA_XILINX=y
CONFIG_FPGA_ZYNQMPPL=y
CONFIG_CMD_PCA953X=y
CONFIG_MISC=y
CONFIG_MMC_SDHCI=y
CONFIG_MMC_SDHCI_ZYNQ=y
CONFIG_SPI=y
CONFIG_ZYNQMP_GQSPI=y
CONFIG_SPI_FLASH_ISSI=y
CONFIG_SPI_FLASH_MACRONIX=y
CONFIG_SPI_FLASH_SPANSION=y
CONFIG_SPI_FLASH_STMICRO=y
CONFIG_SPI_FLASH_WINBOND=y
# CONFIG_SPI_FLASH_USE_4K_SECTORS is not set
CONFIG_PHY_MARVELL=y
CONFIG_PHY_NATSEMI=y
CONFIG_PHY_REALTEK=y
CONFIG_PHY_TI=y
CONFIG_PHY_VITESSE=y
CONFIG_PHY_FIXED=y
CONFIG_PHY_GIGE=y
CONFIG_ZYNQ_GEM=y
CONFIG_SCSI=y
CONFIG_ZYNQ_SERIAL=y
CONFIG_ZYNQMP_QSPI=y
CONFIG_USB=y
CONFIG_USB_XHCI_HCD=y
CONFIG_USB_XHCI_DWC3=y
CONFIG_USB_XHCI_ZYNQMP=y
CONFIG_USB_DWC3=y
CONFIG_USB_DWC3_GADGET=y
CONFIG_USB_DWC3_GENERIC=y
CONFIG_USB_ULPI_VIEWPORT=y
CONFIG_USB_ULPI=y
CONFIG_USB_STORAGE=y
CONFIG_USB_GADGET=y
CONFIG_USB_GADGET_MANUFACTURER="Analog Devices Inc."
CONFIG_USB_GADGET_VENDOR_NUM=0x0456
CONFIG_USB_GADGET_PRODUCT_NUM=0x0300
CONFIG_EFI_LOADER_BOUNCE_BUFFER=y
# CONFIG_TOOLS_MKEFICAPSULE is not set
```

## configs/alif_devkit_e8_defconfig
```kconfig
CONFIG_ARM=y
CONFIG_ARM_SMCCC=y
CONFIG_ARCH_ALIF=y
CONFIG_SYS_MALLOC_LEN=0x100000
CONFIG_CUSTOM_SYS_INIT_SP_ADDR=0x02008000
CONFIG_ENV_SIZE=0x2000
CONFIG_DEFAULT_DEVICE_TREE="alif-devkit-e8"
CONFIG_TARGET_ALIF_DEVKIT_E8=y
CONFIG_SYS_BOOTM_LEN=0x400000
CONFIG_SYS_LOAD_ADDR=0x02100000
CONFIG_DEBUG_UART_BASE=0x4901a000
CONFIG_DEBUG_UART_CLOCK=100000000
CONFIG_DEBUG_UART=y
# CONFIG_EFI_LOADER is not set
# CONFIG_DISPLAY_CPUINFO is not set
# CONFIG_DISPLAY_BOARDINFO is not set
# CONFIG_CMD_BDI is not set
CONFIG_CMD_DHCP=y
CONFIG_CMD_MII=y
CONFIG_CMD_PING=y
CONFIG_NET_RANDOM_ETHADDR=y
CONFIG_PHY_REALTEK=y
CONFIG_DWC_ETH_QOS=y
CONFIG_DWC_ETH_QOS_ALIF=y
CONFIG_DEBUG_UART_SHIFT=2
CONFIG_DEBUG_UART_SKIP_INIT=y
CONFIG_SYSRESET=y
CONFIG_SYSRESET_PSCI=y
```

## configs/sc846-som_defconfig
```kconfig
CONFIG_ARM=y
CONFIG_COUNTER_FREQUENCY=31250000
# CONFIG_ARM64_SUPPORT_AARCH32 is not set
CONFIG_ARCH_SC5XX=y
CONFIG_TEXT_BASE=0x80200000
CONFIG_SYS_MALLOC_LEN=0x80000
CONFIG_SPL_GPIO=y
CONFIG_ENV_SIZE=0x10000
CONFIG_ENV_OFFSET=0x200000
CONFIG_ENV_SECT_SIZE=0x20000
CONFIG_DM_GPIO=y
CONFIG_SPL_DM_SPI=y
CONFIG_SPL_SERIAL=y
CONFIG_SPL_STACK=0x207f0000
CONFIG_SPL_SYS_MALLOC_F_LEN=0x8000
CONFIG_SPL_TEXT_BASE=0x20430000
CONFIG_SPL_BSS_START_ADDR=0x206e0000
CONFIG_SPL_BSS_MAX_SIZE=0x8000
CONFIG_SC846=y
CONFIG_SYS_BOOTM_LEN=0x4000000
# CONFIG_SC5XX_DMC_INIT is not set
CONFIG_SF_DEFAULT_BUS=1
CONFIG_SYS_MEMTEST_START=0x80000000
CONFIG_SYS_MEMTEST_END=0xB0000000
CONFIG_FIT=y
CONFIG_FIT_SIGNATURE=y
CONFIG_LEGACY_IMAGE_FORMAT=y
CONFIG_USE_BOOTCOMMAND=y
CONFIG_BOOTCOMMAND="run spiboot"
CONFIG_SYS_CBSIZE=512
CONFIG_CYCLIC_MAX_CPU_TIME_US=1000
CONFIG_SPL_MAX_SIZE=0x50000
CONFIG_SPL_HAVE_INIT_STACK=y
# CONFIG_SPL_SEPARATE_BSS is not set
CONFIG_SPL_I2C=y
CONFIG_SPL_DM_SPI_FLASH=y
CONFIG_CMD_MEMTEST=y
CONFIG_CMD_DM=y
CONFIG_CMD_MMC=y
# CONFIG_CMD_PINMUX is not set
CONFIG_CMD_REMOTEPROC=y
CONFIG_CMD_SPI=y
CONFIG_DEFAULT_SPI_BUS=1
CONFIG_CMD_USB=y
CONFIG_SYS_DISABLE_AUTOLOAD=y
CONFIG_CMD_DHCP=y
CONFIG_CMD_DNS=y
CONFIG_CMD_MII=y
# CONFIG_CMD_MDIO is not set
CONFIG_CMD_PING=y
CONFIG_CMD_EXT4=y
CONFIG_CMD_EXT4_WRITE=y
CONFIG_OF_EMBED=y
# CONFIG_OF_TAG_MIGRATE is not set
CONFIG_ENV_OVERWRITE=y
CONFIG_ENV_IS_IN_SPI_FLASH=y
CONFIG_ENV_SPI_MAX_HZ=100000000
CONFIG_USE_HOSTNAME=y
CONFIG_HOSTNAME="sc846"
CONFIG_NET_RETRY_COUNT=20
CONFIG_NETCONSOLE=y
CONFIG_IP_DEFRAG=y
CONFIG_USE_GATEWAYIP=y
CONFIG_GATEWAYIP="192.168.0.1"
CONFIG_USE_IPADDR=y
CONFIG_IPADDR="192.168.0.15"
CONFIG_USE_NETMASK=y
CONFIG_NETMASK="255.255.255.0"
CONFIG_USE_ROOTPATH=y
CONFIG_ROOTPATH="/romfs"
CONFIG_USE_SERVERIP=y
CONFIG_SERVERIP="192.168.0.2"
CONFIG_REGMAP=y
CONFIG_SYSCON=y
CONFIG_DMA=y
CONFIG_DMA_CHANNELS=y
CONFIG_ADI_DMA=y
CONFIG_GPIO_HOG=y
CONFIG_SPL_GPIO_HOG=y
CONFIG_DM_GPIO_LOOKUP_LABEL=y
CONFIG_SPL_DM_GPIO_LOOKUP_LABEL=y
CONFIG_MCP230XX_GPIO=y
CONFIG_ADP5588_GPIO=y
CONFIG_DM_I2C=y
CONFIG_DM_I2C_GPIO=y
CONFIG_SYS_I2C_ADI=y
CONFIG_MMC_BROKEN_CD=y
CONFIG_MMC_SDHCI_ADI=y
CONFIG_MMC_SDHCI=y
CONFIG_MMC_SDHCI_ADMA=y
CONFIG_MTD=y
CONFIG_DM_SPI_FLASH=y
CONFIG_SPI_FLASH_SFDP_SUPPORT=y
CONFIG_SPI_FLASH_SOFT_RESET=y
CONFIG_SPI_FLASH_ISSI=y
CONFIG_SPI_FLASH_MACRONIX=y
CONFIG_SPI_FLASH_MTD=y
CONFIG_DWC_ETH_QOS=y
CONFIG_DWC_ETH_QOS_ADI=y
CONFIG_PHY=y
CONFIG_PINCTRL=y
# CONFIG_PINCTRL_GENERIC is not set
CONFIG_SPL_PINCTRL=y
# CONFIG_SPL_PINCTRL_GENERIC is not set
CONFIG_REMOTEPROC_ADI_SC5XX=y
CONFIG_SPI=y
CONFIG_DM_SPI=y
CONFIG_ADI_SPI3=y
CONFIG_CADENCE_QSPI=y
CONFIG_SPL_TIMER=y
CONFIG_USB=y
CONFIG_USB_DWC2=y
CONFIG_USB_STORAGE=y
# CONFIG_SPL_CRC8 is not set
# CONFIG_TOOLS_MKEFICAPSULE is not set
```
